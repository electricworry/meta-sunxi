## conf/machine/include/sun50i-h618.inc
```bitbake
require conf/machine/include/sunxi64.inc

DEFAULTTUNE ?= "cortexa53-crypto"
require conf/machine/include/arm/armv8a/tune-cortexa53.inc

MACHINEOVERRIDES =. "sun50i:"

SOC_FAMILY = "sun50i-h616"
```

## conf/machine/orange-pi-one-plus.conf
```bitbake
#@TYPE: Machine
#@NAME: orange-pi-one-plus
#@DESCRIPTION: Machine configuration for the Orange Pi One Plus, based on Allwinner H6 CPU


require conf/machine/include/sun50i-h6.inc

KERNEL_DEVICETREE = "allwinner/sun50i-h6-orangepi-one-plus.dtb"
UBOOT_MACHINE = "orangepi_one_plus_defconfig"
```

## conf/machine/orange-pi-zero3.conf
```bitbake
#@TYPE: Machine
#@NAME: orange-pi-zero-3
#@DESCRIPTION: Machine configuration for the orange-pi-zero-3, based on Allwinner H618 CPU

require conf/machine/include/sun50i-h616.inc

PREFERRED_PROVIDER_virtual/kernel = "linux-mainline-dev"

KERNEL_DEVICETREE = "allwinner/sun50i-h618-orangepi-zero3.dtb"
UBOOT_MACHINE = "orangepi_zero3_defconfig"

SPL_BINARY = "u-boot-sunxi-with-spl.bin"

MACHINE_FEATURES:append = "bluetooth wifi"

MACHINE_EXTRA_RRECOMMENDS = "uwe5622-firmware \
                             kernel-module-sprdwl-ng \
                             "

KERNEL_MODULE_AUTOLOAD += "sprdbt_tty sprdwl_ng uwe5622_bsp_sdio"
```
